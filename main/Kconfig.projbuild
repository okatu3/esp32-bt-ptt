## main/Kconfig.projbuild
```kconfig
menu "BT-PTT configuration"

    choice BTPTT_BOARD
        prompt "Board / audio hardware"
        default BTPTT_BOARD_AUDIOKIT
        help
            Selects the audio backend and the default pins below.

        config BTPTT_BOARD_AUDIOKIT
            bool "A1S AudioKit v2.2 (ES8388 codec)"
        config BTPTT_BOARD_WROOM
            bool "ESP32-WROOM (internal ADC GPIO34 / DAC GPIO25)"
    endchoice

    config BTPTT_DEVICE_NAME
        string "Bluetooth device name"
        default "BT-PTT"

    config BTPTT_PTT_GPIO
        int "PTT output GPIO (to the radio PTT interface)"
        range 0 33
        default 27 if BTPTT_BOARD_WROOM
        default 19
        help
            GPIO that drives the radio PTT.
            A1S AudioKit v2.2: IO19 on the 2x7 header (also wired to an on-board key).
            ESP32-WROOM: GPIO27.

    config BTPTT_PTT_ACTIVE_HIGH
        bool "PTT output is active high"
        default n
        help
            Off (default): ICOM handhelds. The pin is open-drain and pulls the
            radio MIC/PTT line to GND through ~33-47 kohm while transmitting,
            and floats while receiving.
            On: push-pull, high while transmitting (opto-coupler / transistor).

    config BTPTT_LED_GPIO
        int "TX indicator LED GPIO (-1 = none)"
        range -1 33
        default 2 if BTPTT_BOARD_WROOM
        default 22
        help
            A1S AudioKit v2.2: green LED on GPIO22, lit when the pin is low.
            ESP32-WROOM dev boards: LED on GPIO2 (if fitted), lit when high.

    config BTPTT_LED_ACTIVE_LOW
        bool "TX LED is lit when the pin is low"
        default n if BTPTT_BOARD_WROOM
        default y

    config BTPTT_KEY_GPIO
        int "Local PTT key GPIO (-1 = none)"
        range -1 39
        default 0 if BTPTT_BOARD_WROOM
        default 36
        help
            Push button on the board (active low). Short press toggles PTT,
            holding it for 3 s starts a headset search (pairing).
            A1S AudioKit v2.2: KEY1 = GPIO36. ESP32-WROOM: BOOT button = GPIO0.

    config BTPTT_TOT_DEFAULT_S
        int "Default TX time-out (seconds, 0 = off)"
        range 0 600
        default 180

endmenu
```

## sdkconfig.defaults
```kconfig
CONFIG_IDF_TARGET="esp32"
CONFIG_ESPTOOLPY_FLASHSIZE_4MB=y
CONFIG_PARTITION_TABLE_SINGLE_APP_LARGE=y
CONFIG_FREERTOS_HZ=1000

# Bluetooth Classic only, HFP Audio Gateway
CONFIG_BT_ENABLED=y
CONFIG_BT_BLE_ENABLED=n
CONFIG_BTDM_CTRL_MODE_BR_EDR_ONLY=y
CONFIG_BTDM_CTRL_BR_EDR_MAX_SYNC_CONN=1
CONFIG_BTDM_CTRL_BR_EDR_SCO_DATA_PATH_HCI=y
CONFIG_BT_BLUEDROID_ENABLED=y
CONFIG_BT_CLASSIC_ENABLED=y
CONFIG_BT_HFP_ENABLE=y
CONFIG_BT_HFP_AG_ENABLE=y

# SCO audio goes through HCI to the application as 8 kHz linear PCM (CVSD on air)
CONFIG_BT_HFP_AUDIO_DATA_PATH_HCI=y
CONFIG_BT_HFP_USE_EXTERNAL_CODEC=n
CONFIG_BT_HFP_WBS_ENABLE=n

# esp_codec_dev (ESP-ADF): ES8388 only
CONFIG_CODEC_ES8388_SUPPORT=y
CONFIG_CODEC_ES8311_SUPPORT=n
CONFIG_CODEC_ES7210_SUPPORT=n
CONFIG_CODEC_ES7243_SUPPORT=n
CONFIG_CODEC_ES7243E_SUPPORT=n
CONFIG_CODEC_ES8156_SUPPORT=n
CONFIG_CODEC_AW88298_SUPPORT=n
CONFIG_CODEC_ES8389_SUPPORT=n
CONFIG_CODEC_ES8374_SUPPORT=n
CONFIG_CODEC_TAS5805M_SUPPORT=n
CONFIG_CODEC_ZL38063_SUPPORT=n
CONFIG_CODEC_CJC8910_SUPPORT=n
```
